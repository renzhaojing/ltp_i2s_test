## sdkconfig.defaults
```kconfig
# ESP32-S3 配置
CONFIG_IDF_TARGET="esp32s3"

# I2S 配置
CONFIG_I2S_ENABLE_DEBUG_LOG=n
CONFIG_I2S_ISR_IRAM_SAFE=y

# FreeRTOS 配置
CONFIG_FREERTOS_HZ=1000

# 串口配置
CONFIG_ESP_CONSOLE_UART_DEFAULT=y
CONFIG_ESP_CONSOLE_UART_NUM=0
CONFIG_ESP_CONSOLE_UART_BAUDRATE=115200
```
